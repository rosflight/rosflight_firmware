/*
 *
 * BSD 3-Clause License
 *
 * Copyright (c) 2017, James Jackson - BYU MAGICC Lab, Provo UT
 * All rights reserved.
 *
 * Redistribution and use in source and binary forms, with or without
 * modification, are permitted provided that the following conditions are met:
 *
 * * Redistributions of source code must retain the above copyright notice, this
 *   list of conditions and the following disclaimer.
 *
 * * Redistributions in binary form must reproduce the above copyright notice,
 *   this list of conditions and the following disclaimer in the documentation
 *   and/or other materials provided with the distribution.
 *
 * * Neither the name of the copyright holder nor the names of its
 *   contributors may be used to endorse or promote products derived from
 *   this software without specific prior written permission.
 *
 * THIS SOFTWARE IS PROVIDED BY THE COPYRIGHT HOLDERS AND CONTRIBUTORS "AS IS"
 * AND ANY EXPRESS OR IMPLIED WARRANTIES, INCLUDING, BUT NOT LIMITED TO, THE
 * IMPLIED WARRANTIES OF MERCHANTABILITY AND FITNESS FOR A PARTICULAR PURPOSE ARE
 * DISCLAIMED. IN NO EVENT SHALL THE COPYRIGHT HOLDER OR CONTRIBUTORS BE LIABLE
 * FOR ANY DIRECT, INDIRECT, INCIDENTAL, SPECIAL, EXEMPLARY, OR CONSEQUENTIAL
 * DAMAGES (INCLUDING, BUT NOT LIMITED TO, PROCUREMENT OF SUBSTITUTE GOODS OR
 * SERVICES; LOSS OF USE, DATA, OR PROFITS; OR BUSINESS INTERRUPTION) HOWEVER
 * CAUSED AND ON ANY THEORY OF LIABILITY, WHETHER IN CONTRACT, STRICT LIABILITY,
 * OR TORT (INCLUDING NEGLIGENCE OR OTHERWISE) ARISING IN ANY WAY OUT OF THE USE
 * OF THIS SOFTWARE, EVEN IF ADVISED OF THE POSSIBILITY OF SUCH DAMAGE.
 */

#include <turbotrig/turbotrig.h>

#ifndef M_PI
#define M_PI 3.14159265359
#endif

static const float atan_max_x = 1.000000;
static const float atan_min_x = 0.000000;
static const int16_t atan_num_entries = 500;
static const float atan_scale_factor = 10000.000000;
static const int16_t atan_lookup_table[500] = {
0,	20,	40,	60,	80,	100,	120,	140,	160,	180,
200,	220,	240,	260,	280,	300,	320,	340,	360,	380,
400,	420,	440,	460,	480,	500,	520,	539,	559,	579,
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7753,	7763,	7773,	7783,	7794,	7804,	7814,	7824,	7834,	7844,
};

static const float asin_max_x = 1.000000;
static const float asin_min_x = 0.000000;
static const int16_t asin_num_entries = 500;
static const float asin_scale_factor = 10000.000000;
static const int16_t asin_lookup_table[501] = {
0,	20,	40,	60,	80,	100,	120,	140,	160,	180,
200,	220,	240,	260,	280,	300,	320,	340,	360,	380,
400,	420,	440,	460,	480,	500,	520,	540,	560,	580,
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13705,	13808,	13917,	14033,	14157,	14293,	14442,	14612,	14813,	15075,
15708
};

static const int32_t max_pressure = 106598;
static const int32_t min_pressure = 69681;
static const int16_t num_entries = 500;
static const int16_t dx = 73;
static const int16_t lookup_table[500] = {
30467,  30384,  30301,  30218,  30135,  30052,  29970,  29887,  29804,  29722,
29639,  29557,  29474,  29392,  29310,  29227,  29145,  29063,  28981,  28899,
28818,  28736,  28654,  28573,  28491,  28410,  28328,  28247,  28166,  28084,
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-3707,  -3766,  -3825,  -3885,  -3944,  -4003,  -4062,  -4121,  -4180,  -4239
};

float fsign(float y)
{
  return (0.0 < y) - (y < 0.0);
}

float asin_approx(float x)
{
  return turboasin(x);
}


float turboatan(float x)
{
  // atan is symmetric
  if (x < 0)
  {
    return -1.0*turboatan(-1.0*x);
  }
  // This uses a sweet identity to wrap the domain of atan onto (0,1)
  if (x > 1.0)
  {
    return M_PI/2.0 - turboatan(1.0/x);
  }

  float t = (x - atan_min_x)/(float)(atan_max_x - atan_min_x) * (float)atan_num_entries;
  int16_t index = (int)t;
  float dx = t - index;

  if (index >= atan_num_entries)
      return atan_lookup_table[atan_num_entries-1]/atan_scale_factor;
  else if (index < atan_num_entries - 1)
      return atan_lookup_table[index]/atan_scale_factor + dx * (atan_lookup_table[index + 1] - atan_lookup_table[index])/atan_scale_factor;
  else
      return atan_lookup_table[index]/atan_scale_factor + dx * (atan_lookup_table[index] - atan_lookup_table[index - 1])/atan_scale_factor;
}


float atan2_approx(float y, float x)
{
  // algorithm from wikipedia: https://en.wikipedia.org/wiki/Atan2
  if (x == 0.0)
  {
    if (y < 0.0)
    {
      return - M_PI/2.0;
    }
    else if ( y > 0.0)
    {
      return M_PI/2.0;
    }
    else
    {
      return 0.0;
    }
  }

  float arctan = turboatan(y/x);

  if (x < 0.0)
  {
    if ( y < 0)
    {
      return arctan - M_PI;
    }
    else
    {
      return arctan + M_PI;
    }
  }

  else
  {
      return arctan;
  }
}


float turboasin(float x)
{
  if (x < 0.0)
  {
    return -1.0*turboasin(-1.0*x);
  }

  float t = (x - asin_min_x)/(float)(asin_max_x - asin_min_x) * (float)asin_num_entries;
  int16_t index = (int)t;
  float dx = t - index;

  if (index >= asin_num_entries)
      return asin_lookup_table[500]/asin_scale_factor;
  else if (index < asin_num_entries - 1)
      return asin_lookup_table[index]/asin_scale_factor + dx * (asin_lookup_table[index + 1] - asin_lookup_table[index])/asin_scale_factor;
  else
      return asin_lookup_table[index]/asin_scale_factor + dx * (asin_lookup_table[index] - asin_lookup_table[index - 1])/asin_scale_factor;
}

float fast_alt(float press)
{

  if(press < max_pressure && press > min_pressure)
  {
    float t = (float)num_entries*(press - (float)min_pressure) / (float)(max_pressure - min_pressure);
    int16_t index = (uint16_t)t;
    float dp = t - (float)index;

    float out = 0.0;

    if (index < num_entries - 1)
    {
      out = alt_lookup_table[index]/10.0 + dp * (alt_lookup_table[index + 1] - alt_lookup_table[index])/10.0;
    }
    else
    {
      out = alt_lookup_table[index]/10.0 + dp * (alt_lookup_table[index] - alt_lookup_table[index - 1])/10.0;
    }

    return out;
  }
  else
    return 0.0;
}
